## config/boards/shields/fish/Kconfig.defconfig
```kconfig
# Copyright (c) 2021 The ZMK Contributors
# SPDX-License-Identifier: MIT


if SHIELD_FISH_LEFT
# 右親機にしたければ "if SHIELD_FISH_RIGHT" にする
# Eyelash ドングルを使う場合、左も子機としてビルドされる（build.yaml の fish_left_peripheral）

config ZMK_KEYBOARD_NAME
    default "Fish Keyboard"

config ZMK_SPLIT_ROLE_CENTRAL
    default y

endif


if SHIELD_FISH_DONGLE
# Eyelash ドングルを親機にする

config ZMK_KEYBOARD_NAME
    default "Fish Keyboard"

config ZMK_SPLIT_ROLE_CENTRAL
    default y

endif


if SHIELD_FISH_LEFT || SHIELD_FISH_RIGHT || SHIELD_FISH_DONGLE

config ZMK_SPLIT
    default y

endif
```
